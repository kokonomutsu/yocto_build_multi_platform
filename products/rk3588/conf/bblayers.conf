## products/rk3588/conf/bblayers.conf
```bitbake
# POKY_BBLAYERS_CONF_VERSION is increased each time build/conf/bblayers.conf
# changes incompatibly
POKY_BBLAYERS_CONF_VERSION = "2"

BBPATH = "${TOPDIR}"
BBFILES ?= ""

BBLAYERS ?= " \
  /home/yocto/layers/poky/meta \
  /home/yocto/layers/poky/meta-poky \
  /home/yocto/layers/poky/meta-yocto-bsp \
  /home/yocto/layers/meta-rockchip \
  /home/yocto/layers/meta-arm/meta-arm \
  /home/yocto/layers/meta-arm/meta-arm-toolchain \
  /home/yocto/layers/meta-openembedded/meta-oe \
  /home/yocto/layers/meta-openembedded/meta-python \
  /home/yocto/layers/meta-openembedded/meta-multimedia \
"
```

## products/rk3588/developer/conf/local.conf
```bitbake
#
# RK3588 developer profile — kirkstone layers + custom products/rk3588 layer
#

MACHINE ??= "nanopc-t6"

TMPDIR = "${TOPDIR}/tmp"

DL_DIR ?= "/home/yocto/downloads"
SSTATE_DIR ?= "/home/yocto/sstate-cache"

BB_NUMBER_THREADS ?= "20"
PARALLEL_MAKE ?= "-j20"

BB_DISKMON_DIRS = "\
    STOPTASKS,${TMPDIR},10G,1K \
    STOPTASKS,${DL_DIR},10G,1K \
    STOPTASKS,${SSTATE_DIR},10G,1K \
    HALT,${TMPDIR},5G,1K \
    HALT,${DL_DIR},5G,1K \
    HALT,${SSTATE_DIR},5G,1K \
"

PREFERRED_VERSION_gdb = "10.2"
PACKAGECONFIG:remove:pn-gdb = ""

BB_GIT_SHALLOW = "1"
BB_GENERATE_SHALLOW_TARBALLS = "1"
BB_GIT_SHALLOW_DEPTH = "1"

BB_GENERATE_MIRROR_TARBALLS = "1"
PACKAGE_CLASSES = "package_rpm"

EXTRA_IMAGE_FEATURES ?= "debug-tweaks"

DISTRO ?= "poky"
SDKMACHINE ?= "x86_64"
```
